#include <stdio.h>
#include <stdint.h>

unsigned char __02_Challenger_1985[] = {
  0x56, 0x67, 0x6d, 0x20, 0x42, 0x3c, 0x00, 0x00, 0x51, 0x01, 0x00, 0x00, 0x00, 0x00, 0x00, 0x00,
  0x00, 0x00, 0x00, 0x00, 0x92, 0x3b, 0x00, 0x00, 0xee, 0xe0, 0x12, 0x00, 0x93, 0x13, 0x00, 0x00,
  0x00, 0x04, 0x0e, 0x00, 0x00, 0x00, 0x00, 0x00, 0x00, 0x00, 0x00, 0x00, 0x00, 0x00, 0x00, 0x00,
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  0x21, 0x00, 0x00, 0x00, 0x00, 0x00
};

unsigned int __02_Challenger_1985_len = 15430;

////////////////////////////////////////////////////////////////////////////////
int getu32 (uint8_t *p){

	uint32_t res = 0;

	res = p[3];
	res <<= 8;
	res |= p[2];
	res <<= 8;
	res |= p[1];
	res <<= 8;
	res |= p[0];

	return res;
}

////////////////////////////////////////////////////////////////////////////////
int getu16 (uint8_t *p){

	uint32_t res = 0;

	res = p[1];
	res <<= 8;
	res |= p[0];

	return res;
}

////////////////////////////////////////////////////////////////////////////////
void addbyte (FILE *f, int *col, uint8_t byte){

	
	if (*col > 15){

		*col = 0;
		fprintf(f,"\n.byte ");
	}

	fprintf(f,"0x%02x",byte);
	if (*col < 15)
	fprintf(f,",");
	(*col)++;
}

////////////////////////////////////////////////////////////////////////////////
int main (int argc, char *argv[]){

	uint8_t *p = __02_Challenger_1985;

	printf("ID:");
	printf("%c",p[0]);
	printf("%c",p[1]);
	printf("%c",p[2]);
	printf("%c\n",p[3]);

	printf("EOF:");
	printf("%02x",p[7]);
	printf("%02x",p[6]);
	printf("%02x",p[5]);
	printf("%02x\n",p[4]);

	printf("VER:");
	printf("%02x",p[11]);
	printf("%02x",p[10]);
	printf("%02x",p[9]);
	printf("%02x\n",p[8]);

	int ver = getu32(p+8);

	printf("SN76489_CK:%u\n",getu32(p+0x0c));
	printf("YM2413_CK :%u\n",getu32(p+0x10));
	printf("GD3_OFS   :%u\n",getu32(p+0x14));
	printf("TOT_SMPLS :%u\n",getu32(p+0x18));
	printf("LOOP_OFFS :%u\n",getu32(p+0x1C));
	printf("LOOP_SMPLS:%u\n",getu32(p+0x20));

	uint32_t dt_offset = 0x0c;

	if (ver >= 0x101){

		printf("RATE      :%u\n",getu32(p+0x24));

		if (ver >= 0x110){

			printf("YM2612_CK :%u\n",getu32(p+0x2C));
			printf("YM2151_CK :%u\n",getu32(p+0x30));

			if (ver >= 0x150)
				dt_offset = getu32(p+0x34);

			printf("VGM_DT_OFS:%u\n",dt_offset);

			if (ver >= 0x151){

				printf("SEGAPCM_CK:%u\n",getu32(p+0x38));
				printf("RF5C68_CK :%u\n",getu32(p+0x40));
				printf("YM2203_CK :%u\n",getu32(p+0x44));
				printf("YM2608_CK :%u\n",getu32(p+0x48));
				printf("YM2610_CK :%u\n",getu32(p+0x4C));
				printf("YM3812_CK :%u\n",getu32(p+0x50));
				printf("YM3526_CK :%u\n",getu32(p+0x54));
				printf("Y8950_CK  :%u\n",getu32(p+0x58));
				printf("YMF262_CK :%u\n",getu32(p+0x5C));
				printf("YMF278B_CK:%u\n",getu32(p+0x60));
				printf("YMF271_CK :%u\n",getu32(p+0x64));
				printf("YMZ280B_CK:%u\n",getu32(p+0x68));
				printf("RF5C164_CK:%u\n",getu32(p+0x6C));
				printf("PWM_CK    :%u\n",getu32(p+0x70));
				printf("AY38910_CK:%u\n",getu32(p+0x74));
				printf("AYT BYTE  :%02x\n",p[0x78]);
				printf("AY FLG1   :%02x\n",p[0x79]);
				printf("AY FLG2   :%02x\n",p[0x7A]);
				printf("AY FLG3   :%02x\n",p[0x7B]);

				if (ver >= 0x161){

					printf("GB_DMG_CK :%u\n",getu32(p+0x80));
					printf("NES_APU_CK:%u\n",getu32(p+0x84));
					printf("MULTPCM_CK:%u\n",getu32(p+0x88));
					printf("UPD7759_CK:%u\n",getu32(p+0x8C));
					printf("OKIM6258CK:%u\n",getu32(p+0x90));
					printf("OKIM6295CK:%u\n",getu32(p+0x98));
					printf("K051649_CK:%u\n",getu32(p+0x9C));
					printf("K054539_CK:%u\n",getu32(p+0xA0));
					printf("HuC6280_CK:%u\n",getu32(p+0xA4));
					printf("C140_CK   :%u\n",getu32(p+0xA8));
					printf("K053260_CK:%u\n",getu32(p+0xAC));
					printf("POKEY_CK  :%u\n",getu32(p+0xB0));
					printf("QSOUND_CK :%u\n",getu32(p+0xB4));

					if (ver >= 0x171){

						printf("SCSP_CK   :%u\n",getu32(p+0xB8));
						printf("XTRA_HDROF:%u\n",getu32(p+0xBC));
						printf("WNDRSWANCK:%u\n",getu32(p+0xC0));
						printf("VSU_CK    :%u\n",getu32(p+0xC4));
						printf("SAA1099_CK:%u\n",getu32(p+0xC8));
						printf("ES5503_CK :%u\n",getu32(p+0xCC));
						printf("ES5506_CK :%u\n",getu32(p+0xD0));
						printf("X1-010_CK :%u\n",getu32(p+0xD8));
						printf("C352_CK   :%u\n",getu32(p+0xDC));
						printf("GA20_CK   :%u\n",getu32(p+0xE0));
						
						if (ver >= 0x172){

							printf("MIKEY_CK  :%u\n",getu32(p+0xE4));
						}
					}
				}
			}
		}
	}

	printf("Effective DATA OFFSET:%u\n",0x34+dt_offset);

	uint8_t cmd;

	p = p+(0x34+dt_offset);

	FILE *f = fopen ("challenger.s","w");
	int col = 999;

	for (;;){

		cmd = *p;

		printf("CMD:%02x - ",cmd);
		if ((cmd & 0xF0) == 0x70){	// n+1 samples (a sample is 22.675us)
			
			printf (" Wait %u samples.\n",1 + (cmd & 0x0f));
			p++;
			continue;
		}
		else
		if ((cmd & 0xF0) == 0xA0){	// write reg
			printf (" Write reg: %u <= %u.\n",p[1],p[2]);

			addbyte(f,&col,p[1]);
			addbyte(f,&col,p[2]);
			p += 3;
			continue;
		}
		else
		if (cmd  == 0x61){		// nn samples (a sample is 22.675us)

			uint16_t nsamples = getu16(p+1);

			nsamples += 200;
			int ticks = nsamples / 735;
			while (ticks){

				int qt = ticks > 255 ? 255 : ticks;
				addbyte(f,&col,0x10);
				addbyte(f,&col,qt);
				ticks -= qt;
			}

			printf (" Wait %u samples.\n",nsamples);
			p += 3;
			continue;
		}
		else
		if (cmd  == 0x62){		// 1/60s
			addbyte(f,&col,0x10);
			addbyte(f,&col,0x01);
			printf (" Wait 1/60s.\n");
			p++;
			continue;
		}
		else
		if (cmd  == 0x66){

			addbyte(f,&col,0xff);
			addbyte(f,&col,0xff);
			printf (" END.\n");
			break;
		}
		else
			break;
	}

	fclose(f);

	return 0;
}


